## CMakeLists.txt
```
# SPDX-License-Identifier: Apache-2.0

cmake_minimum_required(VERSION 3.20.0)

find_package(Zephyr REQUIRED HINTS $ENV{ZEPHYR_BASE})
project(kite)

set(ATCA_BUILD_SHARED_LIBS OFF CACHE INTERNAL "")
set(ATCA_PRINTF ON CACHE INTERNAL "")
set(ATCA_HAL_I2C ON CACHE INTERNAL "")
set(ATCA_ATECC608_SUPPORT ON CACHE INTERNAL "")
set(ATCA_POST_DELAY_MS ON CACHE INTERNAL 200)
set(ATCA_NO_HEAP ON CACHE INTERNAL "")
add_subdirectory(cryptoauthlib/lib)

include_directories(app ${CMAKE_CURRENT_BINARY_DIR}/cryptoauthlib/lib
			${CMAKE_CURRENT_SOURCE_DIR}/cryptoauthlib
			${CMAKE_CURRENT_SOURCE_DIR}/cryptoauthlib/lib
			${CMAKE_CURRENT_SOURCE_DIR}/cryptoauthlib/third_party/hal/zephyr)

target_link_libraries(cryptoauth PUBLIC zephyr_interface)
target_link_libraries(app PUBLIC cryptoauth)
target_sources(app PRIVATE src/main.c)
```

## sample.yaml
```
sample:
  description: CTF zephyr
  name: ctf zephyr
common:
  tags: security
  integration_platforms:
    - native_sim
```

## prj.conf
```kconfig
CONFIG_I2C=y
CONFIG_BASE64=y
# This is required to run it on esp32
CONFIG_ESP32_USE_UNSUPPORTED_REVISION=y
```

## boards/esp32_devkitc_wroom_esp32_procpu.overlay
```dts
&i2c0 {
	label = "i2c0";
	clock-frequency = <I2C_BITRATE_STANDARD>;
};
```

## src/main.c
```c
#include <stdio.h>
#include <stdint.h>
#include <zephyr/drivers/i2c.h>
#include <zephyr/kernel.h>
#include <zephyr/sys/base64.h>

#include <atca_basic.h>

#include "secrets.h"

int main(void)
{
	char banner_starting_boctf[] = {
		'.', 'S', 't', 'a', 'r', 't', 'i', 'n', 'g', ' ', 'U',
		'l', 'i', 's', 's', 'e', 'C', 'T', 'F', ' ', 'o', 'n',
		' ', 'E', 'S', 'P', '3', '2', '-', 'W', 'R', 'O', 'O',
		'M', '-', 'A', 'T', 'E', 'C', 'C', '6', '0', '8', 'A',
		'\x0'
	};
	ATCAIfaceCfg cfg = cfg_ateccx08a_i2c_default;
	int status = 0;
	int is_verified = 0;
	uint16_t key_id = ATCA_TEMPKEY_KEYID; 
	atca_aes_gcm_ctx_t ctx;

	uint8_t iv[12] = SECRET_IV;
	uint8_t tag[16] = SECRET_TAG;
	uint8_t key[32] = SECRET_KEY;

	uint8_t encrypted_flag[] = SECRET_FLAG;
	uint8_t plaintext[] = SECRET_FLAG;
	printf("%s\n", banner_starting_boctf);

	cfg.cfg_data = "i2c0";
	cfg.atcai2c.bus = 0;
	cfg.atcai2c.address = 0xc0;

	status = atcab_init(&cfg);
	printf("status: %d\n", status);
	status = atcab_wakeup();
	printf("status: %d\n", status);
	status = atcab_nonce_load(NONCE_MODE_TARGET_TEMPKEY, key, ATCA_KEY_SIZE);
	printf("status: %d\n", status);

	status = atcab_aes_gcm_init(&ctx, key_id, 0, iv, AES_DATA_SIZE - 4);
	printf("status: %d\n", status);
	status = atcab_aes_gcm_decrypt_update(&ctx, encrypted_flag, SECRET_FLAG_LEN, plaintext);
	printf("status: %d\n", status);
	status = atcab_aes_gcm_decrypt_finish(&ctx, tag, 16, &is_verified);
	printf("status: %d\n", status);

	printf("verified: %d\n", is_verified);
	printf("flag: %s\n", plaintext);

	k_panic();
	return 0;
}
```

## src/secrets.h
```c
#ifndef _SECRETS
#define _SECRETS
#define SECRET_KEY { 0xeb, 0x1b, 0xe7, 0x87, 0x57, 0x97, 0x74, 0xbe, 0xa0, 0xb4, 0xf9, 0x17, 0xb6, 0xd4, 0x48, 0xe1, 0x00, 0x00, 0x00, 0x00, 0x00, 0x00, 0x00, 0x00, 0x00, 0x00, 0x00, 0x00, 0x00, 0x00, 0x00, 0x00, }
#define SECRET_IV { 0x52, 0xc0, 0x02, 0xae, 0xc7, 0x17, 0xe1, 0xed, 0x26, 0xdc, 0x81, 0xd3, }
//
#define SECRET_TAG { 0xd4, 0x79, 0xb7, 0x96, 0x88, 0xf6, 0x92, 0xb3, 0x9d, 0x87, 0x3e, 0x6c, 0x70, 0xe7, 0xb5, 0x78, }
#define SECRET_FLAG { 0x04, 0xdf, 0x0f, 0x72, 0x1f, 0x56, 0x4a, 0x08, 0xe8, 0x59, 0x2a, }
#define SECRET_FLAG_LEN 11
#endif /* _SECRETS */
```
